## app/Kconfig
```kconfig
config APP_HEARTBEAT_PERIOD_MS
	int "Heartbeat LED period in milliseconds"
	default 500
	range 100 2000
	help
	  Heartbeat LED blink sleep duration in milliseconds.

source "Kconfig.zephyr"
```

## boards/our_board/board.yml
```yaml
board:
  name: our_board
  full_name: custom
  vendor: st
  socs:
    - name: stm32f429xx
```

## boards/scratch_board/board.yml
```yaml
board:
  name: scratch_board
  full_name: Scratch Board
  vendor: custom
  socs:
    - name: stm32f429xx
```
